## Kconfig
```kconfig
config KDBUS
	tristate "kdbus interprocess message router"
	help
	  kdbus provides efficient kernel-aided message exchange and routing
	  between processes. It is used as the low-level transport of D-Bus.
```
